qcom,7439278_sg865w_5000mah_averaged_masterslave_sept25th2024 {
	qcom,profile-revision = <24>;
	qcom,max-voltage-uv = <4400000>;
	qcom,fg-cc-cv-threshould-mv = <4390>; // TODO: should be qcom,fg-cc-cv-threshold-mv
	qcom,fastchg-current-ma = <5325>;
	qcom,jeita-fcc-ranges = <0 200 1775000
							201 400 5325000
							401 450 5325000
							451 500 4050000
							501 550 1075000>;
	qcom,jeita-fv-ranges = <0 100 4380000
							101 400 4380000
							401 450 4380000
							451 550 4380000>;
	qcom,jeita-hard-thresholds = <0x58cd 0x181d>;
	qcom,nom-batt-capacity-mah = <5000>;
	qcom,batt-id-kohm = <4>;
	qcom,battery-beta = <4250>;
	qcom,therm-room-temp = <100000>;
	qcom,battery-type = "7439278_sg865w_5000mah_averaged_masterslave_sept25th2024";
	qcom,therm-coefficients = <0x2319 0xcb5 0xdb70 0xc48e 0x856b>;
	qcom,therm-center-offset = <0x70>;
	qcom,therm-pull-up = <100>;
	qcom,rslow-normal-coeffs = <0xaf 0x00 0xf8 0x13>;
	qcom,rslow-low-coeffs = <0x6a 0x0b 0x23 0x1b>;
	qcom,checksum = <0x1e80>;
	qcom,gui-version = "PM855GUI - 1.0.0.14";
	qcom,fg-profile-data = [
			09 00 2E E3
			34 BC EF BA
			16 AC 00 00
			F8 B5 1E 83
			FB 87 61 8B
			FC 81 DF 87
			0F 00 AF 00
			F8 13 33 05
			8C 01 CE 07
			32 00 A6 00
			01 80 01 80
			B9 07 57 2A
			92 2A 67 22
			1C 3A 61 3A
			40 00 3C 00
			40 00 3C 00
			31 00 30 00
			37 00 51 00
			48 00 4B 00
			40 00 40 00
			3C 00 34 00
			40 00 37 00
			31 00 71 00
			4E 64 3C 00
			3A 00 40 08
			40 00 34 00
			30 00 4C 10
			3C 10 34 00
			86 20 49 40
			3A 58 32 0B
			40 00 D8 08
			72 1F 9F 15
			82 0A 49 FE
			7E 1C 8F 03
			47 05 21 1B
			59 1A 91 3A
			8E 54 4F 03
			5F 0F 3E 23
			E6 0C 8E 12
			FA 0D 12 1D
			A3 02 FC 05
			93 FA C2 1A
			C0 1B 49 3C
			8D 52 9D 0F
			DB 24 37 04
			F2 02 AC C5
			FE 1C 2D 99
			C9 06 89 AB
			CB 1A 8F 83
			79 84 6D 9A
			AC 90 09 80
			33 00 FC 07
			99 02 F2 FB
			00 F8 12 B4
			FD E2 FB 07
			AE E2 BB 04
			E9 1F 0C 18
			C0 25 F1 03
			78 05 9D 02
			CE 07 32 00
			F7 02 90 02
			AD 04 A4 06
			AD 04 E3 01
			EE 03 D7 04
			76 05 40 00
			3E 00 41 00
			40 64 41 00
			45 00 39 08
			3E 00 41 00
			3F 00 40 08
			40 08 3A 00
			43 28 43 48
			40 60 46 0A
			36 00 36 00
			3F 08 40 00
			40 00 40 00
			36 08 41 10
			3E 00 43 28
			4C 48 35 68
			3B 0A 40 00
			41 00 40 08
			D8 00 D4 20
			82 04 3C 0B
			8F 0D F0 1C
			EC 2A 30 4C
			F0 63 A9 18
			8A 02 43 04
			CA 03 74 0B
			3F 0A E6 1F
			41 05 E7 02
			BD 05 E4 1C
			C0 02 34 04
			29 02 BF 18
			93 02 02 04
			20 02 69 00
			CC 1F 46 05
			FE 02 93 05
			EF 1C 24 02
			7A 05 F4 02
			F9 18 23 02
			1E 05 AB 02
			71 00 60 01
			C0 00 FA 00
			B7 13 00 00
	];
};
