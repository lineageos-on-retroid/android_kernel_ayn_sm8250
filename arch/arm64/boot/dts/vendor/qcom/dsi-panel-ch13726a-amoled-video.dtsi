&mdss_mdp {
	dsi_ch13726a_amoled_video: qcom,mdss_dsi_ch13726a_amoled_video {
		qcom,adjust-timer-wakeup-ms = <1>;
		qcom,dsi-ctrl-num = <0>;
		qcom,dsi-phy-num = <0>;
		qcom,dsi-select-clocks = "mux_byte_clk0", "mux_pixel_clk0";
		qcom,mdss-brightness-max-level = <255>;
		qcom,mdss-dsi-bl-max-level = <255>;
		qcom,mdss-dsi-bl-min-level = <1>;
		qcom,mdss-dsi-bl-pmic-control-type = "bl_ctrl_dcs";
		qcom,mdss-dsi-bllp-eof-power-mode;
		qcom,mdss-dsi-bllp-power-mode;
		qcom,mdss-dsi-border-color = <0>;
		qcom,mdss-dsi-bpp = <24>;
		qcom,mdss-dsi-dma-trigger = "trigger_sw";
		qcom,mdss-dsi-lane-0-state;
		qcom,mdss-dsi-lane-1-state;
		qcom,mdss-dsi-lane-2-state;
		qcom,mdss-dsi-lane-3-state;
		qcom,mdss-dsi-mdp-trigger = "none";
		qcom,mdss-dsi-panel-blackness-level = <3230>;
		qcom,mdss-dsi-panel-hdr-color-primaries = <14500 15500 32000 17000 15500 30000 8000 3000>;
		qcom,mdss-dsi-panel-hdr-enabled;
		qcom,mdss-dsi-panel-name = "ch13726a video mode dsi boe panel with DSC";
		qcom,mdss-dsi-panel-orientation = "180";
		qcom,mdss-dsi-panel-peak-brightness = <4200000>;
		qcom,mdss-dsi-panel-physical-type = "oled";
		qcom,mdss-dsi-panel-type = "dsi_video_mode";
		qcom,mdss-dsi-reset-sequence = <1 10>, <0 10>, <1 10>;
		qcom,mdss-dsi-stream = <0>;
		qcom,mdss-dsi-traffic-mode = "non_burst_sync_event";
		qcom,mdss-dsi-virtual-channel-id = <0>;
		qcom,panel-supply-entries = <&dsi_panel_pwr_supply>;
		qcom,platform-te-gpio = <&tlmm 66 0>;
		qcom,platform-reset-gpio = <&tlmm 75 0>;
		qcom,platform-mipi-mode-sel = <&tlmm 10 0>; /* TODO: not present on msm_drm */
		qcom,platform-mipi-mode-oe = <&tlmm 11 0>; /* TODO: not present on msm_drm */
		qcom,platform-mipi-vdd = <&tlmm 28 0>; /* TODO: not present on msm_drm */
		qcom,mdss-dsi-panel-test-pin = <&tlmm 46 0>;

		qcom,mdss-dsi-display-timings {
			timing@0 {
				qcom,default-topology-index = <0>;
				qcom,display-topology = <1 0 1>, <2 0 1>;
				qcom,mdss-dsi-h-back-porch = <12>;
				qcom,mdss-dsi-h-front-porch = <12>;
				qcom,mdss-dsi-h-pulse-width = <4>;
				qcom,mdss-dsi-h-sync-pulse = <0>;
				qcom,mdss-dsi-h-sync-skew = <0>;
				qcom,mdss-dsi-off-command = [05 01 00 00 32 00 02 28 00 05 01 00 00 78 00 02 10 00 05 01 00 00 05 00 02 4f 01];
				qcom,mdss-dsi-off-command-state = "dsi_hs_mode";
				qcom,mdss-dsi-on-command = [39 01 00 00 00 00 02 F0 50 39 01 00 00 00 00 02 B9 00 05 01 00 00 78 00 02 11 00 05 01 00 00 14 00 02 29 00];
				qcom,mdss-dsi-on-command-state = "dsi_lp_mode";
				qcom,mdss-dsi-panel-clockrate = <778960000>;
				qcom,mdss-dsi-panel-framerate = <60>;
				qcom,mdss-dsi-panel-height = <1920>;
				qcom,mdss-dsi-panel-phy-timings = [00 1b 07 06 16 21 07 07 07 02 04 00 17 0c];
				qcom,mdss-dsi-panel-width = <1080>;
				qcom,mdss-dsi-v-back-porch = <12>;
				qcom,mdss-dsi-v-front-porch = <12>;
				qcom,mdss-dsi-v-pulse-width = <4>;
			};
		};
	};
};
